## drivers/kernelsu/Kconfig
```kconfig
menu "KernelSU"

config KSU
	bool "KernelSU function support"
	depends on !CPU_BIG_ENDIAN
	depends on SECURITY_SELINUX
	select SECCOMP
	default y
	help
	  Enable kernel-level root privileges on Android System.

config KSU_EXTRAS
	bool "Enable custom stuff"
	depends on KSU
	default n
	help
	  Custom extensions. Experimental.
	  Currently, only avc log spoofing is implemented.

config KSU_KPROBES_KSUD
	bool "Enable dynamic kprobes for early boot hooks"
	depends on KPROBES && KRETPROBES
	default y
	help
	  Use dynamic hooks via kprobes for functions only
	  on early boot. Hooks are unregistered at boot complete
	  to reduce overhead.

config KSU_TAMPER_SYSCALL_TABLE
	bool "EXPERIMENTAL: tamper sys_call_table for sucompat + sys_reboot"
	depends on (ARM || ARM64) && !CFI_CLANG && !CFI
	default n
	help
	  EXPERIMENTAL: use syscall table hijacking method demonstrated on zx2c4's
	  kernel-assisted-superuser. Replaces sys_reboot, sys_execve, sys_newfstatat,
	  sys_faccessat, sys_newfstat_ret manual hooks.
	  Personally tested on Linux 3.10 ~ 4.14, aarch64.

config KSU_FEATURE_SULOG
	bool "KernelSU SU Logging feature"
	depends on KSU
	default y
	help
	  Build KernelSU's SU Log.

config KSU_FEATURE_ADBROOT
	bool "KernelSU ADB Root feature"
	depends on KSU
	default y
	help
	  Build KernelSU's adb root feature.

config KSU_DEBUG
	bool "KernelSU debug mode"
	depends on KSU
	default n
	help
	  Enable KernelSU debug mode.

config KSU_THRONE_TRACKER_ALWAYS_THREADED
	bool "Always run throne tracker in a kthread"
	default n
	help
	  Enable this option to run throne tracker in a kthread for the first
	  run, which happens at boot time / decryption stage. This can decrease
	  boot time, but can cause crowning failure on some FDE/FBEv1 setups.
	  If unsure, say n.

config KSU_LSM_SECURITY_HOOKS
	bool "Use LSM security hooks"
        depends on KSU
        default y
	help
	  Disabling this is mostly useful for kernel > 6.8.
	  Make sure to implement manual hooks on security/security.c.

menu "KernelSU - SUSFS"
config KSU_SUSFS
    bool "KernelSU addon - SUSFS"
    depends on KSU
    depends on THREAD_INFO_IN_TASK
    default y
    help
        Patch and Enable SUSFS to kernel with KernelSU.

config KSU_SUSFS_SUS_PATH
    bool "Enable to hide suspicious path (NOT recommended)"
    depends on KSU_SUSFS
    default y
    help
        - Allow hiding the user-defined path and all its sub-paths from various system calls.
        - Includes temp fix for the leaks of app path in /sdcard/Android/data directory.
        - Effective only on zygote spawned user app process.
        - Use with cautious as it may cause performance loss and will be vulnerable to side channel attacks,
          just disable this feature if it doesn't work for you or you don't need it at all.

config KSU_SUSFS_SUS_MOUNT
    bool "Enable to hide suspicious mounts"
    depends on KSU_SUSFS
    default y
    help
        - Allow hiding the user-defined mount paths from /proc/self/[mounts|mountinfo|mountstat].
        - Effective on all processes for hiding mount entries.
        - mnt_id and mnt_group_id of the sus mount will be assigned to a much bigger number to solve the ssue of id not being contiguous.

config KSU_SUSFS_SUS_KSTAT
    bool "Enable to spoof suspicious kstat"
    depends on KSU_SUSFS
    default y
    help
        - Allow spoofing the kstat of user-defined file/directory.
        - Effective only on zygote spawned user app process.

config KSU_SUSFS_TRY_UMOUNT
	bool "Enable to use ksu's try_umount"
	depends on KSU_SUSFS
	default y
	help
		- Allow using try_umount to umount other user-defined mount paths prior to ksu's default umount paths.
		- Effective only on zygote spawned umounted user app process.

config KSU_SUSFS_SPOOF_UNAME
    bool "Enable to spoof uname"
    depends on KSU_SUSFS
    default y
    help
        - Allow spoofing the string returned by uname syscall to user-defined string.
        - Effective on all processes.

config KSU_SUSFS_ENABLE_LOG
    bool "Enable logging susfs log to kernel"
    depends on KSU_SUSFS
    default y
    help
        - Allow logging susfs log to kernel, uncheck it to completely disable all susfs log.

config KSU_SUSFS_HIDE_KSU_SUSFS_SYMBOLS
    bool "Enable to automatically hide ksu and susfs symbols from /proc/kallsyms"
    depends on KSU_SUSFS
    default y
    help
        - Automatically hide ksu and susfs symbols from '/proc/kallsyms'.
        - Effective on all processes.

config KSU_SUSFS_SPOOF_CMDLINE_OR_BOOTCONFIG
    bool "Enable to spoof /proc/bootconfig (gki) or /proc/cmdline (non-gki)"
    depends on KSU_SUSFS
    default y
    help
        - Spoof the output of /proc/bootconfig (gki) or /proc/cmdline (non-gki) with a user-defined file.
        - Effective on all processes.

config KSU_SUSFS_OPEN_REDIRECT
    bool "Enable to redirect a path to be opened with another path (experimental)"
    depends on KSU_SUSFS
    default y
    help
        - Allow redirecting a target path to be opened with another user-defined path.
        - Effective only on processes with uid < 2000.
        - Please be reminded that process with open access to the target and redirected path can be detected.

config KSU_SUSFS_SUS_MAP
    bool "Enable to hide some mmapped real file from different proc maps interfaces"
    depends on KSU_SUSFS
    default y
    help
        - Allow hiding mmapped real file from /proc/<pid>/[maps|smaps|smaps_rollup|map_files|mem|pagemap]
        - It does NOT support hiding for anon memory.
        - It does NOT hide any inline hooks or plt hooks cause by the injected library itself.
        - It may not be able to evade detections by apps that implement a good injection detection.
        - Effective only on zygote spawned umounted user app process.

endmenu

endmenu
```
